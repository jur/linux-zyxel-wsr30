## arch/mips/configs/zyxel_wsr30_defconfig
```kconfig
CONFIG_RTL_NO_BR_SHORTCUT=y
CONFIG_RTL_WTDOG=y
# CONFIG_PHY_EAT_40MHZ is not set
CONFIG_RTL_FLASH_DUAL_IMAGE_ENABLE=y
CONFIG_ZYXEL_RTL_FLASH_DUAL_IMAGE_DISABLE_CHECK_ROOTFS2_SIZE=y
CONFIG_RTL_FLASH_DUAL_IMAGE_OFFSET=0x5000000
CONFIG_ZYXEL_RTL_FLASH_DUAL_IMAGE_REPLACEMENT=y
CONFIG_ZYXEL_NAND_FLASH_APPEND_APP_PARTITION=y
CONFIG_ZYXEL_NAND_FLASH_APPEND_WSR_PARTITION=y
CONFIG_RTL_USB_IP_HOST_SPEEDUP=y
CONFIG_ZYXEL_GPIO_CONTROL_SUPPORT=y
CONFIG_ZYXEL_BLE_PATCH=y
CONFIG_ZYXEL_KERNEL_EVENT_LOG=y
CONFIG_RTL_FLASH_MAPPING_ENABLE=y
CONFIG_RTL_FLASH_SIZE=0x5000000
CONFIG_RTL_HW_SETTING_OFFSET=0x500000
CONFIG_RTL_DEFAULT_SETTING_OFFSET=0x504000
CONFIG_RTL_CURRENT_SETTING_OFFSET=0x50a000
CONFIG_RTL_WEB_PAGES_OFFSET=0x800000
CONFIG_RTL_LINUX_IMAGE_OFFSET=0x900000
CONFIG_RTL_ROOT_IMAGE_OFFSET=0xE00000
CONFIG_BSP_ENABLE_USB=y
CONFIG_PAGE_SIZE_16KB=y
# CONFIG_COMPACTION is not set
CONFIG_MIPS_CMP=y
CONFIG_NR_CPUS=2
CONFIG_HZ_100=y
# CONFIG_SECCOMP is not set
CONFIG_CROSS_COMPILE="mips-linux-"
CONFIG_DEFAULT_HOSTNAME="rlxlinux"
CONFIG_SYSVIPC=y
CONFIG_SYSCTL_SYSCALL=y
CONFIG_EMBEDDED=y
CONFIG_MODULES=y
CONFIG_MODULE_UNLOAD=y
# CONFIG_IOSCHED_CFQ is not set
CONFIG_DEFAULT_NOOP=y
CONFIG_NET=y
CONFIG_PACKET=y
CONFIG_UNIX=y
CONFIG_INET=y
CONFIG_IP_MULTICAST=y
CONFIG_RTL_PPPOE_DIRECT_REPLY=y
# CONFIG_RTL_SUPPORT_ACCESS_PORT_FORWARD_FROM_LAN is not set
CONFIG_NET_IPGRE_DEMUX=y
CONFIG_NET_IPGRE=y
CONFIG_NET_IPGRE_BROADCAST=y
CONFIG_IP_MROUTE=y
# CONFIG_INET_XFRM_MODE_TRANSPORT is not set
# CONFIG_INET_XFRM_MODE_TUNNEL is not set
# CONFIG_INET_XFRM_MODE_BEET is not set
# CONFIG_INET_LRO is not set
CONFIG_IPV6=y
CONFIG_RTL_IPV6READYLOGO=y
CONFIG_IPV6_OPTIMISTIC_DAD=y
CONFIG_IPV6_MULTIPLE_TABLES=y
CONFIG_NETFILTER=y
# CONFIG_BRIDGE_NETFILTER is not set
# CONFIG_RTL_NF_CONNTRACK_GARBAGE_NEW is not set
CONFIG_NF_CONNTRACK=y
CONFIG_NF_CONNTRACK_RTCACHE=m
CONFIG_NF_CT_PROTO_SCTP=m
CONFIG_NF_CONNTRACK_FTP=m
CONFIG_NF_CONNTRACK_H323=m
CONFIG_NF_CONNTRACK_IRC=m
CONFIG_NF_CONNTRACK_RTSP=m
CONFIG_NF_CONNTRACK_SNMP=m
CONFIG_NF_CONNTRACK_PPTP=m
CONFIG_NF_CONNTRACK_SIP=m
CONFIG_NF_CONNTRACK_TFTP=y
CONFIG_NF_CT_NETLINK=m
CONFIG_NETFILTER_XT_TARGET_DSCP=y
CONFIG_NETFILTER_XT_TARGET_VLANPRIORITY=y
CONFIG_NETFILTER_XT_TARGET_LOG=m
CONFIG_NETFILTER_XT_TARGET_MARK=y
CONFIG_NETFILTER_XT_TARGET_TCPMSS=m
CONFIG_NETFILTER_XT_MATCH_COMMENT=y
CONFIG_NETFILTER_XT_MATCH_CONNBYTES=m
CONFIG_NETFILTER_XT_MATCH_CONNLIMIT=m
CONFIG_NETFILTER_XT_MATCH_CONNTRACK=m
CONFIG_NETFILTER_XT_MATCH_DSCP=y
CONFIG_RTL_DSCP_IPTABLE_CHECK=y
CONFIG_NETFILTER_XT_MATCH_IPRANGE=y
CONFIG_NETFILTER_XT_MATCH_LIMIT=m
CONFIG_NETFILTER_XT_MATCH_MAC=y
CONFIG_NETFILTER_XT_MATCH_VLAN=y
CONFIG_RTL_QOS_8021P_SUPPORT=y
CONFIG_RTL_VLANPRI_IPTABLE_CHECK=y
CONFIG_NETFILTER_XT_MATCH_PHYPORT=y
CONFIG_NETFILTER_XT_MATCH_MARK=y
CONFIG_NETFILTER_XT_MATCH_MULTIPORT=m
CONFIG_NETFILTER_XT_MATCH_PKTTYPE=m
CONFIG_NETFILTER_XT_MATCH_RECENT=m
CONFIG_NETFILTER_XT_MATCH_STATE=y
CONFIG_NETFILTER_XT_MATCH_STRING=m
CONFIG_NETFILTER_XT_MATCH_TCPMSS=m
CONFIG_NETFILTER_XT_MATCH_TIME=y
CONFIG_NF_CONNTRACK_IPV4=y
CONFIG_IP_NF_IPTABLES=y
CONFIG_IP_NF_FILTER=y
CONFIG_IP_NF_TARGET_REJECT=m
CONFIG_NF_NAT_IPV4=y
CONFIG_IP_NF_TARGET_MASQUERADE=y
CONFIG_IP_NF_MANGLE=y
CONFIG_IP_NF_RAW=y
CONFIG_NF_CONNTRACK_IPV6=m
CONFIG_IP6_NF_IPTABLES=y
CONFIG_IP6_NF_FILTER=y
CONFIG_IP6_NF_MANGLE=y
CONFIG_L2TP=y
CONFIG_BRIDGE=y
# CONFIG_BRIDGE_IGMP_SNOOPING is not set
CONFIG_VLAN_8021Q=y
CONFIG_NET_SCHED=y
CONFIG_NET_SCH_HTB=y
CONFIG_NET_SCH_SFQ=y
CONFIG_NET_CLS_FW=y
CONFIG_NET_CLS_U32=y
CONFIG_NET_PKTGEN=y
CONFIG_BT=y
CONFIG_BT_RFCOMM=y
CONFIG_BT_HCIUART=y
CONFIG_BT_HCIUART_RTKH5=y
CONFIG_UEVENT_HELPER_PATH="/sbin/hotplug"
CONFIG_MTD=y
CONFIG_MTD_CMDLINE_PARTS=y
CONFIG_MTD_BLOCK=y
CONFIG_MTD_COMPLEX_MAPPINGS=y
CONFIG_MTD_NAND=y
CONFIG_MTD_NAND_RTK=y
CONFIG_IMAGE_HEADER_CHECK=y
CONFIG_SCSI=y
CONFIG_BLK_DEV_SD=y
CONFIG_NETDEVICES=y
# CONFIG_ETHERNET is not set
CONFIG_PPP=y
CONFIG_PPPOE=y
CONFIG_PPP_ASYNC=y
CONFIG_PPP_MPPE_MPPC=y
CONFIG_PPP_SYNC_TTY=y
CONFIG_RTL8192CD=y
CONFIG_WIFI_HCI=y
CONFIG_USB_HCI=y
CONFIG_USB_EXT_PA=y
CONFIG_USB_EXT_LNA=y
CONFIG_USB_ENABLE_EFUSE=y
CONFIG_PCI_HCI=y
CONFIG_SLOT_0_8822BE=y
CONFIG_SLOT_0_RFE_TYPE_11=y
CONFIG_SLOT_0_ENABLE_EFUSE=y
CONFIG_SLOT_1_8822BE=y
CONFIG_SLOT_1_ENABLE_EFUSE=y
CONFIG_LNA_TYPE_3=y
# CONFIG_RTL8190_PRIV_SKB is not set
CONFIG_RTK_SMART_ROAMING=y
CONFIG_RTL_DOT11K_SUPPORT=y
CONFIG_RTL_11V_SUPPORT=y
CONFIG_RTL_HW_NAPT=y
CONFIG_RTL_IVL_SUPPORT=y
# CONFIG_RTL_IPTABLES_RULE_2_ACL is not set
CONFIG_RTL_ETH_PRIV_SKB=y
CONFIG_RTL_PROC_DEBUG=y
CONFIG_RTL_JUMBO_FRAME=y
CONFIG_RTL_EEE_DISABLED=y
# CONFIG_INPUT is not set
# CONFIG_SERIO is not set
# CONFIG_VT is not set
# CONFIG_DEVKMEM is not set
CONFIG_SERIAL_8250=y
CONFIG_SERIAL_8250_CONSOLE=y
# CONFIG_HW_RANDOM is not set
CONFIG_I2C=y
CONFIG_RTL8198C_I2C=y
CONFIG_RTL8198C_I2C_SUPPORT_LEDS_LP55231=y
# CONFIG_HWMON is not set
CONFIG_USB_ARCH_HAS_XHCI=y
CONFIG_USB=y
CONFIG_USB_XHCI_HCD=y
CONFIG_USB_STORAGE=y
CONFIG_DWC_OTG=y
CONFIG_LEDS_LP55XX_COMMON_DISABLE_RESET_AND_ENABLE=y
CONFIG_LEDS_LP5523_PREDEFINED_PATTERNS=y
CONFIG_LEDS_LP5523_EXTENDED_FW=y
CONFIG_LEDS_TRIGGERS=y
CONFIG_LEDS_TRIGGER_TIMER=y
CONFIG_LEDS_TRIGGER_DEFAULT_ON=y
CONFIG_FUSE_FS=y
CONFIG_MSDOS_FS=y
CONFIG_VFAT_FS=y
CONFIG_PROC_KCORE=y
CONFIG_YAFFS_FS=y
CONFIG_YAFFS_DISABLE_TAGS_ECC=y
CONFIG_SQUASHFS=y
# CONFIG_SQUASHFS_ZLIB is not set
CONFIG_SQUASHFS_XZ=y
CONFIG_SQUASHFS_EMBEDDED=y
# CONFIG_NETWORK_FILESYSTEMS is not set
CONFIG_NLS_CODEPAGE_437=y
CONFIG_NLS_ISO8859_1=y
CONFIG_STRIP_ASM_SYMS=y
CONFIG_DEBUG_FS=y
CONFIG_RCU_CPU_STALL_TIMEOUT=60
CONFIG_EARLY_PRINTK=y
CONFIG_CMDLINE_BOOL=y
CONFIG_CMDLINE="console=ttyS0,38400 root=/dev/mtdblock3 root2=/dev/mtdblock6"
CONFIG_CMDLINE_OVERRIDE=y
CONFIG_CRYPTO_CRC32=y
# CONFIG_CRYPTO_ANSI_CPRNG is not set
CONFIG_LIBCRC32C=y
```
